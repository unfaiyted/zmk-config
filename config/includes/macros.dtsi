
/ {
    macros {
        password: password {
            compatible = "zmk,behavior-macro";
            #binding-cells = <0>;
            bindings
                = <&macro_press &kp LSHFT>
                , <&macro_tap &kp N4 &kp N4 &kp N3 &kp N3 &kp N2 &kp N2 &kp N1 &kp N1>
                , <&macro_release &kp LSHFT>
                ;
        };

        tmux: tmux {
            compatible = "zmk,behavior-macro-one-param";
            label = "Tmux";
            #binding-cells = <1>;
            tap-ms = <50>;
            bindings
                = <&macro_press &kp LCTRL &kp A>
                , <&macro_pause_for_release>
                , <&macro_release &kp LCTRL &kp A> 
                , <&macro_tap &kp MACRO_PLACEHOLDER>
                ;

          };
    };
};
